## build/conf/bblayers.conf
```bitbake
LCONF_VERSION = "7"

BBPATH = "${TOPDIR}"
BBFILES ?= ""

BBLAYERS ?= " \
    /storage/xilinx_2021.1/xilinx-build/sources/core/meta \
    /storage/xilinx_2021.1/xilinx-build/sources/core/meta-poky \
    /storage/xilinx_2021.1/xilinx-build/sources/core/../meta-openembedded/meta-perl \
    /storage/xilinx_2021.1/xilinx-build/sources/core/../meta-openembedded/meta-python \
    /storage/xilinx_2021.1/xilinx-build/sources/core/../meta-openembedded/meta-filesystems \
    /storage/xilinx_2021.1/xilinx-build/sources/core/../meta-openembedded/meta-gnome \
    /storage/xilinx_2021.1/xilinx-build/sources/core/../meta-openembedded/meta-multimedia \
    /storage/xilinx_2021.1/xilinx-build/sources/core/../meta-openembedded/meta-networking \
    /storage/xilinx_2021.1/xilinx-build/sources/core/../meta-openembedded/meta-webserver \
    /storage/xilinx_2021.1/xilinx-build/sources/core/../meta-openembedded/meta-xfce \
    /storage/xilinx_2021.1/xilinx-build/sources/core/../meta-openembedded/meta-initramfs \
    /storage/xilinx_2021.1/xilinx-build/sources/core/../meta-openembedded/meta-oe \
    /storage/xilinx_2021.1/xilinx-build/sources/core/../meta-clang \
    /storage/xilinx_2021.1/xilinx-build/sources/core/../meta-browser/meta-chromium \
    /storage/xilinx_2021.1/xilinx-build/sources/core/../meta-qt5 \
    /storage/xilinx_2021.1/xilinx-build/sources/core/../meta-xilinx/meta-microblaze \
    /storage/xilinx_2021.1/xilinx-build/sources/core/../meta-xilinx/meta-xilinx-bsp \
    /storage/xilinx_2021.1/xilinx-build/sources/core/../meta-xilinx/meta-xilinx-pynq \
    /storage/xilinx_2021.1/xilinx-build/sources/core/../meta-xilinx/meta-xilinx-contrib \
    /storage/xilinx_2021.1/xilinx-build/sources/core/../meta-xilinx/meta-xilinx-standalone \
    /storage/xilinx_2021.1/xilinx-build/sources/core/../meta-xilinx-tools \
    /storage/xilinx_2021.1/xilinx-build/sources/core/../meta-petalinux \
    /storage/xilinx_2021.1/xilinx-build/sources/core/../meta-virtualization \
    /storage/xilinx_2021.1/xilinx-build/sources/core/../meta-openamp \
    /storage/xilinx_2021.1/xilinx-build/sources/core/../meta-jupyter \
    /storage/xilinx_2021.1/xilinx-build/sources/core/../meta-python2 \
    /storage/xilinx_2021.1/xilinx-build/sources/core/../meta-som \
    /storage/xilinx_2021.1/xilinx-build/sources/core/../meta-security \
    /storage/xilinx_2021.1/xilinx-build/sources/meta-sdr \
    /storage/xilinx_2021.1/xilinx-build/sources/meta-zynq-gr \
    /storage/xilinx_2021.1/xilinx-build/sources/core/../meta-security/meta-tpm \
"

BBLAYERS_NON_REMOVABLE ?= " \
    /storage/xilinx_2021.1/xilinx-build/sources/core/meta \
"
```

## build/sources/mali/rel-v2016.1/MALI-userspace/meta-xilinx/conf/machine/include/tune-zynqmp.inc
```bitbake
DEFAULTTUNE ?= "aarch64"
SOC_FAMILY ?= "zynqmp"

require conf/machine/include/arm/arch-armv8.inc
require conf/machine/include/soc-family.inc

# Linux Configuration
KERNEL_IMAGETYPE ?= "Image"

# KMACHINE
KMACHINE ?= "zynqmp"

XSERVER_append = "xf86-video-armsoc"

PREFERRED_PROVIDER_virtual/libgles1 = "libmali-xlnx"
PREFERRED_PROVIDER_virtual/libgles2 = "libmali-xlnx"
PREFERRED_PROVIDER_virtual/egl = "libmali-xlnx"
```

## sources/meta-zynq-gr/conf/layer.conf
```bitbake
# We have a conf and classes directory, add to BBPATH
BBPATH .= ":${LAYERDIR}"

# We have recipes-* directories, add to BBFILES
BBFILES += "${LAYERDIR}/recipes-*/*/*.bb \
            ${LAYERDIR}/recipes-*/*/*.bbappend"

BBFILE_COLLECTIONS += "meta-zynq-gr"
BBFILE_PATTERN_meta-zynq-gr = "^${LAYERDIR}/"
BBFILE_PRIORITY_meta-zynq-gr = "4"

LAYERDEPENDS_meta-zynq-gr = "core"
LAYERSERIES_COMPAT_meta-zynq-gr = "warrior zeus gatesgarth"
```
